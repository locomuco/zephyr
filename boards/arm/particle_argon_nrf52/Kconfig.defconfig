## boards/arm/particle_argon_nrf52/Kconfig.defconfig
```kconfig
# Kconfig - Particle Agron board configuration
#
# Copyright (c) 2018 Matthias Boesl
#
# SPDX-License-Identifier: Apache-2.0

if BOARD_PARTICLE_ARGON_NRF52

config BOARD
	default "particle_argon_nrf52" if BOARD_PARTICLE_ARGON_NRF52

if USB

config USB_NRF52840
	default y

config USB_DEVICE_STACK
	default y

endif # USB

if IEEE802154

config IEEE802154_NRF5
	default y

endif # IEEE802154

endif # BOARD_PARTICLE_ARGON
```

## boards/arm/tado_ib01/Kconfig.board
```kconfig
# Kconfig - TADO IB01 board configuration
#
# Copyright (c) 2018 Matthias Boesl
#
# SPDX-License-Identifier: Apache-2.0
#

config BOARD_TADO_IB01
	bool "tado Internet Bridge"
	depends on SOC_STM32F411XE
```

## boards/arm/tado_ib01/Kconfig.defconfig
```kconfig
# Kconfig - TADO IB01 board configuration
#
# Copyright (c) 2016 Matthias Boesl
#
# SPDX-License-Identifier: Apache-2.0
#

if BOARD_TADO_IB01

config BOARD
	default tado_ib01

endif # BOARD_TADO_IB01
```

## boards/arm/tado_ib01/tado_ib01_defconfig
```kconfig
CONFIG_ARM=y
CONFIG_BOARD_TADO_IB01=y
CONFIG_SOC_SERIES_STM32F4X=y
CONFIG_SOC_STM32F411XE=y
# System
CONFIG_SYS_CLOCK_HW_CYCLES_PER_SEC=72000000
CONFIG_SYS_CLOCK_TICKS_PER_SEC=1000

# clock configuration
CONFIG_CLOCK_CONTROL=y

# Clock configuration for Cube Clock control driver
CONFIG_CLOCK_STM32_HSE_CLOCK=26000000
CONFIG_CLOCK_STM32_SYSCLK_SRC_PLL=y
# use HSE as PLL input
CONFIG_CLOCK_STM32_PLL_SRC_HSE=y
# however, the board does not have an external oscillator, so just use
# the 8MHz clock signal coming from integrated STLink
CONFIG_CLOCK_STM32_HSE_BYPASS=n
# produce 84MHz clock at PLL output
CONFIG_CLOCK_STM32_PLL_M_DIVISOR=13
CONFIG_CLOCK_STM32_PLL_N_MULTIPLIER=216
CONFIG_CLOCK_STM32_PLL_P_DIVISOR=6
CONFIG_CLOCK_STM32_PLL_Q_DIVISOR=9
CONFIG_CLOCK_STM32_AHB_PRESCALER=1
CONFIG_CLOCK_STM32_APB1_PRESCALER=2
CONFIG_CLOCK_STM32_APB2_PRESCALER=1

# RNG
CONFIG_TEST_RANDOM_GENERATOR=y
CONFIG_TIMER_RANDOM_GENERATOR=y

# Enable MPU
CONFIG_STM32_ARM_MPU_ENABLE=y

# GPIO
CONFIG_GPIO=y

# PINMUX
CONFIG_PINMUX=y

# USART
CONFIG_SERIAL=y
CONFIG_UART_STM32_PORT_1=y
CONFIG_UART_STM32_PORT_2=y
CONFIG_UART_INTERRUPT_DRIVEN=y
CONFIG_CONSOLE=y
CONFIG_UART_CONSOLE=y

# SPI config
CONFIG_SPI=y
CONFIG_SPI_STM32=y
CONFIG_USE_STM32_LL_SPI=y

# SPI2 for ENC28J60 (master)
CONFIG_SPI_2=y
CONFIG_SPI_2_OP_MODES=1

# SPI1 for CC1101 (master)
CONFIG_SPI_1=y
CONFIG_SPI_1_OP_MODES=1

# ENC28J60
CONFIG_ETH_ENC28J60=y
CONFIG_ETH_INIT_PRIORITY=80
CONFIG_ETH_ENC28J60_RX_THREAD_STACK_SIZE=800
CONFIG_ETH_ENC28J60_RX_THREAD_PRIO=2
CONFIG_ETH_EN28J60_TIMEOUT=100
CONFIG_ETH_ENC28J60_0=y
CONFIG_ETH_ENC28J60_0_NAME="ETH_0"
CONFIG_ETH_EN28J60_0_FULL_DUPLEX=y
CONFIG_ETH_ENC28J60_0_GPIO_PORT_NAME="GPIOB"
CONFIG_ETH_ENC28J60_0_GPIO_PIN=2
CONFIG_ETH_ENC28J60_0_SPI_PORT_NAME="SPI_2"
CONFIG_ETH_ENC28J60_0_SLAVE=1
CONFIG_ETH_ENC28J60_0_GPIO_SPI_CS=y
CONFIG_ETH_ENC28J60_0_SPI_CS_PORT_NAME="GPIOB"
CONFIG_ETH_ENC28J60_0_SPI_CS_PIN=12
CONFIG_ETH_ENC28J60_0_SPI_BUS_FREQ=10000000
CONFIG_ETH_ENC28J60_0_MAC3=0x2D
CONFIG_ETH_ENC28J60_0_MAC4=0x30
CONFIG_ETH_ENC28J60_0_MAC5=0x32

# CC1101
CONFIG_IEEE802154=y
CONFIG_IEEE802154_CC1101=y
CONFIG_IEEE802154_CC1101_DRV_NAME="RF_0"
CONFIG_IEEE802154_CC1101_SPI_DRV_NAME="SPI_1"
CONFIG_IEEE802154_CC1101_GPIO_SPI_CS=y
CONFIG_IEEE802154_CC1101_GPIO_SPI_CS_DRV_NAME="GPIOA"
CONFIG_IEEE802154_CC1101_GPIO_SPI_CS_PIN=4
CONFIG_IEEE802154_CC1101_SPI_FREQ=3000000
CONFIG_IEEE802154_CC1101_GDO0_INT_PORT="GPIOA"
CONFIG_IEEE802154_CC1101_GDO0_INT_PIN=0
CONFIG_IEEE802154_CC1101_GDO2_INT_PORT="GPIOA"
CONFIG_IEEE802154_CC1101_GDO0_INT_PIN=1
CONFIG_IEEE802154_CC1101_RX_STACK_SIZE=800

# Networking
CONFIG_NETWORKING=y
CONFIG_NET_L2_IEEE802154=y
CONFIG_NET_L2_ETHERNET=y
```

## boards/arm/tado_ru02/Kconfig
```kconfig
# Kconfig - tado° RU02 board configuration
#
# Copyright (c) 2017 Tado GmbH
#
# SPDX-License-Identifier: Apache-2.0

if BOARD_TADO_RU02

config  GPIO_AS_PINRESET
	bool "GPIO as pin reset (reset button)"
	default y

config NFCT_PINS_AS_GPIOS
	bool "NFCT pins as GPIO"
	default y

endif # BOARD_TADO_RU02
```

## boards/arm/tado_ru02/Kconfig.board
```kconfig
# Kconfig - tado° RU02 board configuration
#
# Copyright (c) 2017 Tado GmbH
#
# SPDX-License-Identifier: Apache-2.0

config  BOARD_TADO_RU02
	bool "tado RU02"
	depends on SOC_NRF52832_QFAA
```

## boards/arm/tado_ru02/Kconfig.defconfig
```kconfig
# Kconfig - tado° RU02 board configuration
#
# Copyright (c) 2017 Tado GmbH
#
# SPDX-License-Identifier: Apache-2.0

if BOARD_TADO_RU02

config BOARD
	default tado_ru02

if SOC_FLASH_NRF5 

# Avoid MCUB-90 bug on nRF5x targets:
# mcuboot cannot detect default flash page size without this API and fallbacks
# to strange defaults/hacks. 
config FLASH_PAGE_LAYOUT
	default y

endif # SOC_FLASH_NRF5

if GPIO_NRF5

config GPIO_NRF5_P0
	default y

endif # GPIO_NRF5

if UART_NRF5

config UART_NRF5_GPIO_TX_PIN
	default 6

config UART_NRF5_GPIO_RX_PIN
	default 8

config UART_NRF5_GPIO_RTS_PIN
	default 5

config UART_NRF5_GPIO_CTS_PIN
	default 7

endif # UART_NRF5

if FLASH && SPI

config SPI_FLASH_W25QXXDV
	def_bool y

config GPIO
	def_bool y

config SPI_CS_GPIO
	def_bool y

endif # FLASH && SPI

endif # BOARD_TADO_RU02XX
```

## boards/arm/tado_ru02/tado_ru02_defconfig
```kconfig
CONFIG_ARM=y
CONFIG_SOC_FAMILY_NRF=y
CONFIG_SOC_SERIES_NRF52X=y
CONFIG_SOC_NRF52832_QFAA=y
CONFIG_BOARD_TADO_RU02XX=y

# Enable MPU
CONFIG_ARM_MPU_NRF52X=y

# Enable generic Serial driver necessary for SPI
CONFIG_SERIAL=y
# Do not use UART driver by default for stdout
# CONFIG_UART_CONSOLE is not set

# GPIO: dependency of SPI (e.g. chip select control)
CONFIG_GPIO=y
CONFIG_GPIO_NRF5=y
CONFIG_GPIO_NRF5_P0=y
CONFIG_GPIO_NRF5_P0_DEV_NAME="GPIO_0"

# Internal flash
CONFIG_FLASH=y
CONFIG_SOC_FLASH_NRF=y
# Avoid MPU access violation during writing slot confirmation from app
CONFIG_MPU_ALLOW_FLASH_WRITE=y

## SPI: enable for external flash support (8 byte word size, 8 MHz)
CONFIG_SPI=y
CONFIG_SPI_INIT_PRIORITY=51
CONFIG_SPI_CS_GPIO=y
CONFIG_SPI_1=y
CONFIG_SPI_1_NAME="SPI_1"
CONFIG_SPI_1_OP_MODES=1
CONFIG_SPI_1_IRQ_PRI=3
CONFIG_SPI_1_CS_GPIO_PORT="GPIO_0"
# SPI Flash CS
CONFIG_SPI_1_CS_GPIO_PIN=27

CONFIG_SPI_NRFX=y
CONFIG_SPI_1_NRF_SPI=y
# CONFIG_SPI_1_NRF_SPIS is not set
CONFIG_SPI_1_NRF_SCK_PIN=28
CONFIG_SPI_1_NRF_MOSI_PIN=29
CONFIG_SPI_1_NRF_MISO_PIN=30

## External SPI flash
CONFIG_FLASH_RDID_VERIFY=y
CONFIG_FLASH_HAS_PAGE_LAYOUT=y
CONFIG_SPI_FLASH_W25QXXDV=y
CONFIG_SPI_FLASH_W25QXXDV_SPI_NAME="SPI_1"
CONFIG_SPI_FLASH_W25QXXDV_DRV_NAME="W25QXXDV"
CONFIG_SPI_FLASH_W25QXXDV_SPI_FREQ_0=8000000
CONFIG_SPI_FLASH_W25QXXDV_SPI_SLAVE=1
CONFIG_SPI_FLASH_W25QXXDV_RDID=0xc22814
CONFIG_SPI_FLASH_W25QXXDV_FLASH_SIZE=1048576
CONFIG_SPI_FLASH_W25QXXDV_MAX_DATA_LEN=256

# Enable console and use RTT by default for log output
CONFIG_CONSOLE=y
CONFIG_STDOUT_CONSOLE=y
CONFIG_HAS_SEGGER_RTT=y
CONFIG_RTT_CONSOLE=y

# Additional board options
CONFIG_GPIO_AS_PINRESET=y
CONFIG_NFCT_PINS_AS_GPIOS=y

# Bluetooth
CONFIG_BT=n
#CONFIG_BT_CTLR=y
```

## boards/arm/tado_ru02xx/Kconfig.board
```kconfig
# Kconfig - tado° RU02XX board configuration
#
# Copyright (c) 2017 Tado GmbH
#
# SPDX-License-Identifier: Apache-2.0

config  BOARD_TADO_RU02XX
	bool "tado RU02XX"
	depends on SOC_NRF52832_QFAA
```

## boards/arm/tado_ru02xx/tado_ru02xx_defconfig
```kconfig
CONFIG_ARM=y
CONFIG_SOC_FAMILY_NRF5=y
CONFIG_SOC_SERIES_NRF52X=y
CONFIG_SOC_NRF52832_QFAA=y
CONFIG_BOARD_TADO_RU02XX=y

# Enable MPU
CONFIG_ARM_MPU_NRF52X=y

# Enable generic Serial driver necessary for SPI
CONFIG_SERIAL=y
# Do not use UART driver by default for stdout
# CONFIG_UART_CONSOLE is not set

# Enable console and use RTT by default for log output
CONFIG_CONSOLE=y
CONFIG_STDOUT_CONSOLE=y
CONFIG_HAS_SEGGER_RTT=y
CONFIG_RTT_CONSOLE=y

# Additional board options
CONFIG_GPIO_AS_PINRESET=y
CONFIG_NFCT_PINS_AS_GPIOS=y

# Bluetooth
CONFIG_BT=n
#CONFIG_BT_CTLR=y
```
